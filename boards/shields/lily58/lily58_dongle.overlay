#include <dt-bindings/zmk/matrix_transform.h>
#include <layouts/kata0510/lily58.dtsi>

//&kata0510_lily58_layout {
//    transform = <&default_transform>;
//};

/ {
    chosen {
        zmk,kscan = &mock_kscan;
        zmk,physical-layout = &kata0510_lily58_layout;
    };

    mock_kscan: mock_kscan_0 {
        compatible = "zmk,kscan-mock";
        columns = <0>;
        rows = <0>;
        events = <0>;
    };
};
